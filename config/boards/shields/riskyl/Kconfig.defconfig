## config/boards/shields/riskyl/Kconfig.defconfig
```kconfig
if SHIELD_RISKYL_LEFT

config ZMK_KEYBOARD_NAME
    default "riskyl"

config ZMK_SPLIT_ROLE_CENTRAL
    default y

endif

if SHIELD_RISKYL_LEFT || SHIELD_RISKYL_RIGHT

config ZMK_SPLIT
    default y

endif
```
